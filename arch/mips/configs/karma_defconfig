## arch/mips/configs/karma_defconfig
```kconfig
CONFIG_KARMA_L4=y
CONFIG_KARMA_L4_FB=y
CONFIG_KARMA_L4_PCI=y
CONFIG_KARMA_L4_DMA=y
CONFIG_KARMA_L4_BLKDEV_INTERVM=y
CONFIG_KARMA_PKG_PATH="/path/to/l4/pkg/karma"
CONFIG_MACH_VIRT=y
CONFIG_CPU_MIPS32_R2=y
CONFIG_PAGE_SIZE_16KB=y
CONFIG_HZ_100=y
CONFIG_SYSVIPC=y
CONFIG_IKCONFIG=y
CONFIG_LOG_BUF_SHIFT=15
CONFIG_BLK_DEV_INITRD=y
CONFIG_SYSCTL_SYSCALL=y
CONFIG_EMBEDDED=y
# CONFIG_COMPAT_BRK is not set
CONFIG_SLAB=y
# CONFIG_BLK_DEV_BSG is not set
CONFIG_PCI=y
CONFIG_PCI_DEBUG=y
CONFIG_NET=y
CONFIG_INET=y
# CONFIG_WIRELESS is not set
CONFIG_BLK_DEV_RAM=y
CONFIG_IDE=y
CONFIG_IDE_GENERIC=y
CONFIG_BLK_DEV_GENERIC=y
CONFIG_BLK_DEV_PIIX=y
CONFIG_NETDEVICES=y
CONFIG_PCNET32=y
# CONFIG_WLAN is not set
# CONFIG_VGA_ARB is not set
CONFIG_FRAMEBUFFER_CONSOLE_DETECT_PRIMARY=y
CONFIG_LOGO=y
CONFIG_SOUND=y
CONFIG_SND=y
CONFIG_SND_SEQUENCER=y
CONFIG_SND_SEQ_DUMMY=y
CONFIG_SND_MIXER_OSS=y
CONFIG_SND_PCM_OSS=y
CONFIG_SND_DUMMY=y
CONFIG_SND_ALOOP=y
# CONFIG_SND_PCI is not set
CONFIG_EXT2_FS=y
CONFIG_EXT2_FS_XATTR=y
CONFIG_EXT3_FS=y
CONFIG_EXT4_FS=y
CONFIG_PROC_KCORE=y
CONFIG_TMPFS=y
CONFIG_DEBUG_FS=y
CONFIG_DEBUG_INFO=y
CONFIG_DYNAMIC_DEBUG=y
```

## arch/mips/configs/karma_simple_defconfig
```kconfig
CONFIG_KARMA_L4=y
CONFIG_KARMA_PKG_PATH="/path/to/l4/pkg/karma"
CONFIG_MACH_VIRT=y
CONFIG_CPU_MIPS32_R2=y
CONFIG_PAGE_SIZE_16KB=y
CONFIG_HZ_100=y
CONFIG_SYSVIPC=y
CONFIG_IKCONFIG=y
CONFIG_LOG_BUF_SHIFT=15
CONFIG_BLK_DEV_INITRD=y
CONFIG_SYSCTL_SYSCALL=y
CONFIG_EMBEDDED=y
# CONFIG_COMPAT_BRK is not set
CONFIG_SLAB=y
# CONFIG_BLOCK is not set
CONFIG_FB=y
CONFIG_FRAMEBUFFER_CONSOLE=y
CONFIG_FRAMEBUFFER_CONSOLE_DETECT_PRIMARY=y
CONFIG_LOGO=y
CONFIG_SOUND=y
CONFIG_SND=y
CONFIG_SND_SEQUENCER=y
CONFIG_SND_SEQ_DUMMY=y
CONFIG_SND_MIXER_OSS=y
CONFIG_SND_PCM_OSS=y
CONFIG_SND_DUMMY=y
CONFIG_SND_ALOOP=y
CONFIG_PROC_KCORE=y
CONFIG_TMPFS=y
CONFIG_DEBUG_FS=y
CONFIG_DEBUG_INFO=y
CONFIG_DYNAMIC_DEBUG=y
CONFIG_CRYPTO=y
CONFIG_CRYPTO_CRC32C=y
CONFIG_CRC16=y
```

## arch/mips/mach-virt/Kconfig
```kconfig
config VIRT_HOST_FREQ
	int "Virtual Host Processor Frequency (MHz)"
	depends on MACH_VIRT
	default 200
	help
	  Select this option when building a guest virtual machine to set the
	  guest CPU frequency and skip RTC emulation when determining the
	  frequency.
```

## arch/mips/paravirt/Kconfig
```kconfig
if MIPS_PARAVIRT

config MIPS_PCI_VIRTIO
	def_bool y
	depends on VIRTIO_PCI

endif #  MIPS_PARAVIRT
```
